## conf/layer.conf
```bitbake
# We have a conf directory, append to BBPATH
BBPATH .= ":${LAYERDIR}"

# We have a recipes directory, add to BBFILES
BBFILES += " \
	${LAYERDIR}/recipes-*/*/*.bb \
	${LAYERDIR}/recipes-*/*/*.bbappend \
"

BBFILE_COLLECTIONS += "parallelphp"
BBFILE_PATTERN_parallelphp := "^${LAYERDIR}/"
BBFILE_PRIORITY_parallelphp = "5"

LAYERVERSION_parallelphp = "1"
LAYERSERIES_COMPAT_parallelphp = "honister"

LAYERDEPENDS_parallelphp = "core openembedded-layer"
```
